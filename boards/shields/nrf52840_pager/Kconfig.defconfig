## boards/shields/nrf52840_pager/Kconfig.defconfig
```kconfig
if SHIELD_NRF52840_PAGER

config ZMK_KEYBOARD_NAME
    default "nRF52840_pager"

endif # SHIELD_NRF52840_PAGER
```

## boards/shields/nrf52840_pager/Kconfig.shield
```kconfig
config SHIELD_NRF52840_PAGER
    def_bool $(shields_list_contains,nrf52840_pager)
```
